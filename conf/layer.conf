## conf/layer.conf
```bitbake
# We have a conf and classes directory, add to BBPATH
BBPATH .= ":${LAYERDIR}"

# We have recipes-* directories, add to BBFILES
BBFILES += "${LAYERDIR}/recipes-*/*/*.bb \
	${LAYERDIR}/recipes-*/*/*.bbappend"

BBFILE_COLLECTIONS += "baylibre-agl-chromium-test"
BBFILE_PATTERN_baylibre-agl-chromium-test = "^${LAYERDIR}/"

# Priority must be > 7 for bbappend to be applied after agl-demo
BBFILE_PRIORITY_baylibre-agl-chromium-test = "8"

LAYERDEPENDS_baylibre-agl-chromium-test = "browser-layer agl-demo app-framework"
```
